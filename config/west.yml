## config/west.yml
```yaml
manifest:
  remotes:
    - name: zmkfirmware
      url-base: https://github.com/cbc-mkb
  projects:
    - name: zmk
      remote: zmkfirmware
      revision: mouse-pim447
      import: app/west.yml
  self:
    path: config
```
